## firmware/main/Kconfig.projbuild
```kconfig
menu "VibeMic"

config VIBEMIC_USE_INMP441
    bool "Capture from INMP441 (I2S MEMS mic)"
    default y
    help
        Initialize I2S RX for INMP441 on PIN_I2S_CLK/WS/DIN.
        If channel setup fails, firmware falls back to the 440 Hz test tone on PTT.

config VIBEMIC_MIC_TONE_FALLBACK
    bool "Use tone when mic frames stay silent"
    depends on VIBEMIC_USE_INMP441
    default y
    help
        Before the mic arrives, I2S may open but return near-silence.
        Keep streaming the test tone on PTT until a non-silent frame is seen once.

config VIBEMIC_ENABLE_TOUCHPAD_PROBE
    bool "Probe I2C touchpad at boot"
    default n
    help
        When enabled, firmware attempts a simple I2C probe and sets CAPS.has_touchpad.

endmenu
```

## firmware/sdkconfig.defaults
```kconfig
CONFIG_BT_ENABLED=y
CONFIG_BT_NIMBLE_ENABLED=y
CONFIG_BT_CONTROLLER_ENABLED=y
CONFIG_BT_BLE_ENABLED=y
CONFIG_BT_BLUEDROID_ENABLED=n
CONFIG_BTDM_CTRL_MODE_BLE_ONLY=y
CONFIG_NIMBLE_MAX_CONNECTIONS=1
CONFIG_BT_NIMBLE_GATT_MAX_PROCS=8
CONFIG_BT_NIMBLE_ATT_PREFERRED_MTU=247
CONFIG_BT_NIMBLE_MSYS_1_BLOCK_COUNT=24
CONFIG_FREERTOS_HZ=1000
CONFIG_ESP_MAIN_TASK_STACK_SIZE=8192
# C3 default; override with idf.py set-target
CONFIG_IDF_TARGET_ESP32C3=y
```

## firmware/sdkconfig.defaults.esp32
```kconfig
# Applied when idf.py set-target esp32
CONFIG_BT_ENABLED=y
CONFIG_BT_NIMBLE_ENABLED=y
CONFIG_BTDM_CTRL_MODE_BLE_ONLY=y
CONFIG_BT_BLUEDROID_ENABLED=n
CONFIG_BT_NIMBLE_ATT_PREFERRED_MTU=247
CONFIG_ESP_MAIN_TASK_STACK_SIZE=8192
```
